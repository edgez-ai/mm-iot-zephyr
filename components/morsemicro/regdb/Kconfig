## components/morsemicro/regdb/Kconfig
```kconfig
# Copyright 2026 Morse Micro
# SPDX-License-Identifier: Apache-2.0

menu "Regulatory Database"

config WIFI_MORSEMICRO_REGION
	string "Device regulatory domain"
	default "00"
	help
	  Specifies the regulatory domain for which to operate the device.
	  Defaults to 00, which then requires the application calls wifi_mgmt_regdomain
	  with a region that is supported by the BCF

config WIFI_MORSEMICRO_RUNTIME_REGION
	bool "Application supplies country before initial radio startup"
	default n
	help
	  Override the weak morsemicro_get_country_code() hook to select a
	  board-specific country, for example from factory storage. The hook
	  runs during network interface initialization and must not block or
	  require services initialized later. Unsupported countries leave RF off.

choice WIFI_MORSEMICRO_AU_CHANNELISATION
	prompt "Australian channelisation configuration"
	default WIFI_MORSEMICRO_AU_CHANNELISATION_REVMF
	help
		Australia's channelisation rules for 802.11ah changed in the 2024
		version of the 802.11 standard. Additionally, there is a proposal for
		2028 which includes better positioned 8 MHz channels.

	config WIFI_MORSEMICRO_AU_CHANNELISATION_2020
		bool "802.11-2020"
	config WIFI_MORSEMICRO_AU_CHANNELISATION_2024
		bool "802.11-2024"
	config WIFI_MORSEMICRO_AU_CHANNELISATION_REVMF
		bool "802.11-revmf"
endchoice

endmenu
```
